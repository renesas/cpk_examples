/*
 * perf_cac.c
 *
 *  Created on: March 6, 2026
 *      Author: Ran Qingling
 */
#include <perf_cac.h>
#include "console.h"
#include "hal_data.h"
#include "common_utils.h"
#include "coremark/coremark.h"
#include "perf_counter/perf_counter.h"

extern bsp_leds_t g_bsp_leds;
static volatile cac_event_t g_cac_event = (cac_event_t)CAC_EVENT_VALUE;
static volatile bool b_cac_status_flag  = false;

/* Private function */
static fsp_err_t cac_measurement_process(void);

FSP_CPP_HEADER
void R_BSP_WarmStart(bsp_warm_start_event_t event);
FSP_CPP_FOOTER

/*******************************************************************************************************************//**
 * main() is generated by the RA Configuration editor and is used to generate threads if an RTOS is used. This function
 * is called by main() when no RTOS is used.
 **********************************************************************************************************************/
CODE_AREA
void cac_test(void)
{
    fsp_err_t err                                  = FSP_SUCCESS;
    fsp_pack_version_t version                     = {RESET_VALUE};
    uint16_t cgc_time_out                          = UINT16_MAX;
    uint8_t rtt_input_buf[BUFFER_SIZE_DOWN]        = {RESET_VALUE};
    /* Used to get reference clock from CAC configurable property "Reference clock source" */
    cac_clock_source_t ref_clk                     = (cac_clock_source_t)RESET_VALUE;
    /* Used to get target clock from CAC configurable property "Measurement clock source" */
    cac_clock_source_t target_clk                  = (cac_clock_source_t)RESET_VALUE;
    /* Supported clocks in this EP */
    uint8_t target_cgc_clk_src[TARGET_CGC_CLK_CNT] = {TARGET_CLOCK_SOURCE_MAIN_OSC,
                                                      TARGET_CLOCK_SOURCE_SUBCLOCK,
                                                      TARGET_CLOCK_SOURCE_HOCO,
                                                      TARGET_CLOCK_SOURCE_MOCO,
                                                      TARGET_CLOCK_SOURCE_LOCO,
                                                      TARGET_CLOCK_SOURCE_PCLKB};

    /* Open CGC module */
    err = R_CGC_Open(&g_cgc_ctrl, &g_cgc_cfg);
    /* Handle error */
    if(FSP_SUCCESS != err)
    {
        printf("\r\n** R_CGC_Open API FAILED **\r\n");
        printf("\r\nReturned Error Code: 0x%x  \r\n", (err));
    }

    /* Open CAC module */
    err = R_CAC_Open(&g_cac_ctrl, &g_cac_cfg);
    /* Handle error */
    if (FSP_SUCCESS != err)
    {
        printf("\r\n** R_CAC_Open API FAILED **\r\n");

        /* De-initialize all the opened modules before trap */
        deinit_cgc();
        printf("\r\nReturned Error Code: 0x%x  \r\n", (err));
    }

    /* Copy the reference clock selected from configurator to local buffer */
    ref_clk = g_cac_cfg.cac_ref_clock.clock;

    /* If reference clock is not IWDT clock, then start and check stability of reference clock
     * selected in configurator */
    if ((CAC_CLOCK_SOURCE_IWDT != ref_clk) && (CAC_CLOCK_SOURCE_EXTERNAL != ref_clk))
    {
        /* Start selected target clock */
        err = R_CGC_ClockStart(&g_cgc_ctrl, (cgc_clock_t)target_cgc_clk_src[ref_clk], NULL);
        if(FSP_SUCCESS != err)
        {
            printf("\r\n** R_CGC_ClockStart API FAILED **\r\n");
            /* Close all the opened modules before trap */
            clean_up();
            printf("\r\nReturned Error Code: 0x%x  \r\n", (err));
        }

        /* Check selected target clock for stability */
        do
        {
            /* Start checking for timeout to avoid infinite loop */
            --cgc_time_out;

            err = R_CGC_ClockCheck(&g_cgc_ctrl, (cgc_clock_t)target_cgc_clk_src[ref_clk]);

            /* Check for time elapse */
            if ((RESET_VALUE == cgc_time_out) || (FSP_ERR_CLOCK_INACTIVE == err))
            {
                /* We have reached to a scenario where CGC clock is not stabilized */
                printf("\r\n** Unable to stabilize CGC clock **\r\n");
                /* Close all the opened modules before trap */
                clean_up();
                printf("\r\nReturned Error Code: 0x%x  \r\n", (err));
            }
        }while(FSP_ERR_NOT_STABILIZED == err);
        printf("\r\nSelected CGC Reference clock started and stabilized\r\n");
    }

    /* Copy the target clock selected from configurator to local buffer */
    target_clk = g_cac_cfg.cac_meas_clock.clock;

    /* If target clock is not IWDT clock, then start and check stability of target clock
     * selected in configurator */
    if (CAC_CLOCK_SOURCE_IWDT != target_clk)
    {
        /* Start selected target clock */
        err = R_CGC_ClockStart(&g_cgc_ctrl, (cgc_clock_t)target_cgc_clk_src[target_clk], NULL);
        if(FSP_SUCCESS != err)
        {
            printf("\r\n** R_CGC_ClockStart API FAILED **\r\n");
            /* Close all the opened modules before trap */
            clean_up();
            printf("\r\nReturned Error Code: 0x%x  \r\n", (err));
        }

        /* Check selected target clock for stability */
        do
        {
            /* Start checking for timeout to avoid infinite loop */
            --cgc_time_out;

            err = R_CGC_ClockCheck(&g_cgc_ctrl, (cgc_clock_t)target_cgc_clk_src[target_clk]);

            /* Check for time elapse */
            if ((RESET_VALUE == cgc_time_out) || (FSP_ERR_CLOCK_INACTIVE == err))
            {
                /* We have reached to a scenario where CGC clock is not stabilized */
                printf("\r\n** Unable to stabilize CGC clock **\r\n");
                /* Close all the opened modules before trap */
                clean_up();
                printf("\r\nReturned Error Code: 0x%x  \r\n", (err));
            }
        }while(FSP_ERR_NOT_STABILIZED == err);
        printf("\r\nSelected CGC Target clock started and stabilized\r\n");
    }

    printf("\r\nEnter any key to perform CAC measurement operation\r\n");

    printf("\r\nStart CAC measurement operation\r\n");
    /* Process CAC measurement operation */
    err = cac_measurement_process();
    if(FSP_SUCCESS != err)
    {
        printf("\r\n** CAC MEASUREMENT PROCESS FAILED **\r\n");
        /* Close all the opened modules before trap */
        clean_up();
        printf("\r\nReturned Error Code: 0x%x  \r\n", (err));
    }

}

/*******************************************************************************************************************//**
 *  @brief       Perform CAC measurement operation
 *  @param[IN]   None
 *  @retval      FSP_SUCCESS     Upon successful CAC measurement.
 *  @retval      Any error code other than FSP_SUCCESS if the measurement fails.
 **********************************************************************************************************************/
CODE_AREA
static fsp_err_t cac_measurement_process(void)
{
    fsp_err_t err                     = FSP_SUCCESS;
    uint32_t cac_counter_val          = RESET_VALUE;
    volatile uint16_t cac_time_out    = UINT16_MAX;

    /* Reset flags before starting CAC measurement */
    g_cac_event = (cac_event_t) CAC_EVENT_VALUE;
    b_cac_status_flag = false;

    /* Begin a measurement */
    err = R_CAC_StartMeasurement(&g_cac_ctrl);
    if (FSP_SUCCESS != err)
    {
        printf("\r\n** R_CAC_StartMeasurement API FAILED **\r\n");
        return err;
    }

    printf("\r\nCAC measurement started\r\n");

    /* Wait for measurement complete or error generation event */
    do
    {
        /* Start checking for timeout to avoid an infinite loop */
        --cac_time_out;

        /* Check for time elapsed */
        if (RESET_VALUE == cac_time_out)
        {
            /* We have reached a scenario where CAC event has not occurred */
            printf("\r\n** No event received during CAC measurement operation **\r\n");
            return FSP_ERR_TIMEOUT;
        }
    } while (true != b_cac_status_flag);


    /* Check for event received from CAC callback */
    switch (g_cac_event)
    {
        case CAC_EVENT_MEASUREMENT_COMPLETE :
        {
            err = R_CAC_Read(&g_cac_ctrl, &cac_counter_val);
            if (FSP_SUCCESS != err)
            {
                printf("\r\n** R_CAC_Read API FAILED **\r\n");
                return err;
            }

            printf("\r\nCAC measurement completed and selected target clock is accurate\r\n");
            printf("\r\nCAC counter value : %d\r\n", cac_counter_val);

            /* Stop a measurement */
            err = R_CAC_StopMeasurement(&g_cac_ctrl);
            if (FSP_SUCCESS != err)
            {
                printf("\r\n** R_CAC_StopMeasurement API FAILED **\r\n");
                return err;
            }
            printf("\r\nCAC measurement stopped\r\n");
        }
        break;

        case CAC_EVENT_FREQUENCY_ERROR :
        {
            printf("\r\n** Frequency error occurred and CAC counter value is not in range of configured upper "
                          "and lower limit **\r\n");

            /* Return from here as counter value is not in the range of configured upper limit and lower limit */
            err = FSP_ERR_INVALID_CAC_REF_CLOCK;
        }
        break;

        default :
        {
            printf("\r\n** CAC counter overflow occurred **\r\n");

            /* Return from here as counter buffer overflows */
            err = FSP_ERR_OVERFLOW;
        }
        break;
    }

    return err;
}

/*******************************************************************************************************************//**
 * @brief      User defined CAC callback.
 * @param[IN]  p_args
 * @retval     None
 **********************************************************************************************************************/
CODE_AREA
void cac_callback(cac_callback_args_t *p_args)
{
    if (NULL != p_args)
    {
        g_cac_event = p_args->event;
        b_cac_status_flag = true;
    }
}

/*******************************************************************************************************************//**
 * @brief      Closes the CAC HAL driver.
 * @param[IN]  None
 * @retval     None
 **********************************************************************************************************************/
CODE_AREA
void deinit_cac(void)
{
    fsp_err_t err = FSP_SUCCESS;

    /* Close CAC module */
    err = R_CAC_Close(&g_cac_ctrl);
    /* Handle error */
    if (FSP_SUCCESS != err)
    {
        printf("\r\n** R_CAC_Close API FAILED **\r\n");
    }
}
CODE_AREA
void deinit_cgc(void)
{
    fsp_err_t err = FSP_SUCCESS;

    /* Close CGC module */
    err = R_CGC_Close(&g_cgc_ctrl);
    /* Handle error */
    if (FSP_SUCCESS != err)
    {
        printf("\r\n** R_CGC_Close API FAILED **\r\n");
    }
}

/*****************************************************************************************************************
 *  @brief      Closes all modules.
 *  @param[in]  None
 *  @retval     None
 ****************************************************************************************************************/
CODE_AREA
void clean_up(void)
{
    /* De-initialize all the opened modules before trap */
    deinit_cac();
    deinit_cgc();
}

