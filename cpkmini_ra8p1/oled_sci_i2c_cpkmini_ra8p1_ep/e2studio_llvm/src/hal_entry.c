#include "console.h"
#include "hal_data.h"
#include "iic.h"

#include "oled/oled.h"
#include "perf_counter/perf_counter.h"
#include "SEGGER_RTT/SEGGER_RTT.h"
#include "utils/log.h"

#if (1 == BSP_MULTICORE_PROJECT) && BSP_TZ_SECURE_BUILD
bsp_ipc_semaphore_handle_t g_core_start_semaphore =
{
    .semaphore_num = 0
};
#endif

static OLED_Dev s_oled;

static uint32_t oledWrite(uint8_t *val, uint16_t len, bool iscmd);

/*******************************************************************************************************************//**
 * main() is generated by the RA Configuration editor and is used to generate threads if an RTOS is used.  This function
 * is called by main() when no RTOS is used.
 **********************************************************************************************************************/
void hal_entry(void)
{
	/* TODO: add your own code here */
	int64_t time_start, time_end;

	perfc_init(false);
#if CONSOLE_CFG_USE_RTT == 0
	SEGGER_RTT_Init();
#endif
	CONSOLE_Init();

	/* Clean screen */
#if CONSOLE_CFG_USE_RTT
    puts(RTT_CTRL_RESET);
    puts(RTT_CTRL_CLEAR);
#else
    puts("\x1b[2J\x1b[H");
    puts("\x1B[0m");
#endif

    IIC_Init();

    s_oled.write = oledWrite;
    OLED_Init(&s_oled);

	/* Wake up 2nd core if this is first core and we are inside a multicore project. */
#if (0 == _RA_CORE) && (1 == BSP_MULTICORE_PROJECT) && !BSP_TZ_NONSECURE_BUILD

#if BSP_TZ_SECURE_BUILD
    /* Take semaphore so 2nd core can clear it */
    R_BSP_IpcSemaphoreTake(&g_core_start_semaphore);
#endif

    R_BSP_SecondaryCoreStart();

#if BSP_TZ_SECURE_BUILD
    /* Wait for 2nd core to start and clear semaphore */
    while(FSP_ERR_IN_USE == R_BSP_IpcSemaphoreTake(&g_core_start_semaphore))
    {
        ;
    }
#endif
#endif

#if (1 == _RA_CORE) && (1 == BSP_MULTICORE_PROJECT) && BSP_TZ_SECURE_BUILD
    /* Signal to 1st core that 2nd core has started */
    R_BSP_IpcSemaphoreGive(&g_core_start_semaphore);
#endif

    time_start = get_system_ms();
    OLED_Fill(&s_oled, 0x00);
    time_end = get_system_ms();
    printf("Fill screen using %" PRId64 "ms", time_end - time_start);

    OLED_DrawStr(&s_oled, 0, 0, "CPKHMI-RA8P1", OLED_FONT_8X16);
    OLED_DrawStr(&s_oled, 0, 2, "with", OLED_FONT_8X16);
    OLED_DrawStr(&s_oled, 0, 4, "CPKExp-MINI", OLED_FONT_8X16);

    while (1) {
        R_IOPORT_PinWrite(g_ioport.p_ctrl, USER_LED, BSP_IO_LEVEL_HIGH);
    	R_BSP_SoftwareDelay(500, BSP_DELAY_UNITS_MILLISECONDS);
    	R_IOPORT_PinWrite(g_ioport.p_ctrl, USER_LED, BSP_IO_LEVEL_LOW);
    	R_BSP_SoftwareDelay(500, BSP_DELAY_UNITS_MILLISECONDS);
    }

#if BSP_TZ_SECURE_BUILD
    /* Enter non-secure code */
    R_BSP_NonSecureEnter();
#endif
}

#if BSP_TZ_SECURE_BUILD

FSP_CPP_HEADER
BSP_CMSE_NONSECURE_ENTRY void template_nonsecure_callable ();

/* Trustzone Secure Projects require at least one nonsecure callable function in order to build (Remove this if it is not required to build). */
BSP_CMSE_NONSECURE_ENTRY void template_nonsecure_callable ()
{

}
FSP_CPP_FOOTER

#endif

#if LOG_CFG_EN_TIMESTAMP
void LOG_GetTime(uint32_t *s, uint32_t *ms)
{
	int64_t t = get_system_ms();
	*s = (uint32_t)(t / 1000);
	*ms = (uint32_t)(t % 1000);
}
#endif

static uint32_t oledWrite(uint8_t *val, uint16_t len, bool iscmd)
{
	uint32_t err;

	(void)len;

	if (iscmd) {
		err = IIC_WriteReg(0x3C, 0x00, 8, *val, 8);
	}
	else {
		err = IIC_WriteReg(0x3C, 0x40, 8, *val, 8);
	}

	return err;
}
