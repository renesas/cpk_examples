#include "hal_data.h"

#if (1 == BSP_MULTICORE_PROJECT) && BSP_TZ_SECURE_BUILD
bsp_ipc_semaphore_handle_t g_core_start_semaphore =
{
    .semaphore_num = 0
};
#endif

/*******************************************************************************************************************//**
 * main() is generated by the RA Configuration editor and is used to generate threads if an RTOS is used.  This function
 * is called by main() when no RTOS is used.
 **********************************************************************************************************************/
void hal_entry(void)
{
	/* TODO: add your own code here */
	R_GPT_Open(g_timer0.p_ctrl, g_timer0.p_cfg);
	R_GPT_Start(g_timer0.p_ctrl);

	/* Wake up 2nd core if this is first core and we are inside a multicore project. */
#if (0 == _RA_CORE) && (1 == BSP_MULTICORE_PROJECT) && !BSP_TZ_NONSECURE_BUILD

#if BSP_TZ_SECURE_BUILD
    /* Take semaphore so 2nd core can clear it */
    R_BSP_IpcSemaphoreTake(&g_core_start_semaphore);
#endif

    R_BSP_SecondaryCoreStart();

#if BSP_TZ_SECURE_BUILD
    /* Wait for 2nd core to start and clear semaphore */
    while(FSP_ERR_IN_USE == R_BSP_IpcSemaphoreTake(&g_core_start_semaphore))
    {
        ;
    }
#endif
#endif

#if (1 == _RA_CORE) && (1 == BSP_MULTICORE_PROJECT) && BSP_TZ_SECURE_BUILD
    /* Signal to 1st core that 2nd core has started */
    R_BSP_IpcSemaphoreGive(&g_core_start_semaphore);
#endif

    while (1) {
    	R_IOPORT_PinWrite(g_ioport.p_ctrl, USER_LED, BSP_IO_LEVEL_HIGH);
    	R_BSP_SoftwareDelay(500, BSP_DELAY_UNITS_MILLISECONDS);
    	R_IOPORT_PinWrite(g_ioport.p_ctrl, USER_LED, BSP_IO_LEVEL_LOW);
    	R_BSP_SoftwareDelay(500, BSP_DELAY_UNITS_MILLISECONDS);
    }

#if BSP_TZ_SECURE_BUILD
    /* Enter non-secure code */
    R_BSP_NonSecureEnter();
#endif
}

#if BSP_TZ_SECURE_BUILD

FSP_CPP_HEADER
BSP_CMSE_NONSECURE_ENTRY void template_nonsecure_callable ();

/* Trustzone Secure Projects require at least one nonsecure callable function in order to build (Remove this if it is not required to build). */
BSP_CMSE_NONSECURE_ENTRY void template_nonsecure_callable ()
{

}
FSP_CPP_FOOTER

#endif

void TIMER0_Callback(timer_callback_args_t *p_args)
{
	bsp_io_level_t level;

	if (p_args->event == TIMER_EVENT_CYCLE_END) {
		R_IOPORT_PinRead(g_ioport.p_ctrl, BSP_IO_PORT_12_PIN_05, &level);
		if (level == BSP_IO_LEVEL_HIGH) {
			R_IOPORT_PinWrite(g_ioport.p_ctrl, BSP_IO_PORT_12_PIN_15, BSP_IO_LEVEL_LOW);
		}
		else {
			R_IOPORT_PinWrite(g_ioport.p_ctrl, BSP_IO_PORT_12_PIN_15, BSP_IO_LEVEL_HIGH);
		}
	}
}
