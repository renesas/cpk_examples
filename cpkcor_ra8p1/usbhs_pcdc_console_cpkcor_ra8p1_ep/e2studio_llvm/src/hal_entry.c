#include <inttypes.h>
#include <stdbool.h>
#include <stdio.h>
#include "console.h"
#include "hal_data.h"
#include "iic.h"

#include "fusb303b/fusb303b.h"
#include "perf_counter/perf_counter.h"
#include "SEGGER_RTT/SEGGER_RTT.h"
#include "utils/log.h"

#define RECEIVE_SIZE	128

#if (1 == BSP_MULTICORE_PROJECT) && BSP_TZ_SECURE_BUILD
bsp_ipc_semaphore_handle_t g_core_start_semaphore =
{
    .semaphore_num = 0
};
#endif

static volatile uint8_t s_irq_flag;
static uint8_t s_rdata[RECEIVE_SIZE + 1];
static volatile uint32_t s_time_cnt;

static void wait_usb_attach(bool console_inited);

/*******************************************************************************************************************//**
 * main() is generated by the RA Configuration editor and is used to generate threads if an RTOS is used.  This function
 * is called by main() when no RTOS is used.
 **********************************************************************************************************************/
void hal_entry(void)
{
	/* TODO: add your own code here */
	uint32_t rlen;
	FUSB303_Status fusb_status;

	uint32_t cnt = 0;

	perfc_init(false);
#if CONSOLE_CFG_USE_RTT == 0
	SEGGER_RTT_Init();
#endif

	IIC_Init();
    FUSB303B_Init();
    R_GPT_Open(g_timer0.p_ctrl, g_timer0.p_cfg);
    R_GPT_Start(g_timer0.p_ctrl);
    R_ICU_ExternalIrqOpen(g_external_irq24.p_ctrl, g_external_irq24.p_cfg);
	R_ICU_ExternalIrqEnable(g_external_irq24.p_ctrl);

	/* Wake up 2nd core if this is first core and we are inside a multicore project. */
#if (0 == _RA_CORE) && (1 == BSP_MULTICORE_PROJECT) && !BSP_TZ_NONSECURE_BUILD

#if BSP_TZ_SECURE_BUILD
    /* Take semaphore so 2nd core can clear it */
    R_BSP_IpcSemaphoreTake(&g_core_start_semaphore);
#endif

    R_BSP_SecondaryCoreStart();

#if BSP_TZ_SECURE_BUILD
    /* Wait for 2nd core to start and clear semaphore */
    while(FSP_ERR_IN_USE == R_BSP_IpcSemaphoreTake(&g_core_start_semaphore))
    {
        ;
    }
#endif
#endif

#if (1 == _RA_CORE) && (1 == BSP_MULTICORE_PROJECT) && BSP_TZ_SECURE_BUILD
    /* Signal to 1st core that 2nd core has started */
    R_BSP_IpcSemaphoreGive(&g_core_start_semaphore);
#endif

    memset(s_rdata, 0, RECEIVE_SIZE + 1);
    wait_usb_attach(false);
    CONSOLE_Init();

    printf("FSP Version: %s\r\n", FSP_VERSION_STRING);

    while (1) {
    	CONSOLE_Task();

    	if (s_time_cnt > 1000) {
    		s_time_cnt = 0;
    		printf("Redirect stdio to USB, cnt: %" PRIu32 "\r\n", cnt);
    		cnt++;
    	}

    	if (CONSOLE_HasData()) {
    		rlen = CONSOLE_Read(s_rdata, RECEIVE_SIZE);
    		if (rlen > 0) {
				printf("Received: %s", s_rdata);
				if (s_rdata[rlen - 1] != '\n') {
					printf("\r\n");
				}
    		}
    		memset(s_rdata, 0, RECEIVE_SIZE);
    	}

    	if (s_irq_flag) {
    		FUSB303B_Check(&fusb_status);
    		if (fusb_status.attached == 0) {
    			printf("USB detach\r\n");
    			wait_usb_attach(true);
    			printf("USB attach and as a sink");
    			s_time_cnt = 0;
    		}
    	}
    }

#if BSP_TZ_SECURE_BUILD
    /* Enter non-secure code */
    R_BSP_NonSecureEnter();
#endif
}

#if BSP_TZ_SECURE_BUILD

FSP_CPP_HEADER
BSP_CMSE_NONSECURE_ENTRY void template_nonsecure_callable ();

/* Trustzone Secure Projects require at least one nonsecure callable function in order to build (Remove this if it is not required to build). */
BSP_CMSE_NONSECURE_ENTRY void template_nonsecure_callable ()
{

}
FSP_CPP_FOOTER

#endif

#if LOG_CFG_EN_TIMESTAMP
void LOG_GetTime(uint32_t *s, uint32_t *ms)
{
	int64_t t = get_system_ms();
	*s = (uint32_t)(t / 1000);
	*ms = (uint32_t)(t % 1000);
}
#endif

void TIMER0_Callback(timer_callback_args_t *p_args)
{
	if (p_args->event == TIMER_EVENT_CYCLE_END) {
		s_time_cnt++;
	}
}

void ExternalIRQ_Callback(external_irq_callback_args_t *p_args)
{
	if (p_args->channel == 24) {
		s_irq_flag = 1;
	}
}

static void wait_usb_attach(bool console_inited)
{
	FUSB303_Status status;

	FUSB303B_Check(&status);
	while (status.type != DETECT_TYPE_SINK) {
		if (s_irq_flag) {
			s_irq_flag = 0;
			FUSB303B_Check(&status);
		}
		if (console_inited) {
			CONSOLE_Task();
		}
	}
}
