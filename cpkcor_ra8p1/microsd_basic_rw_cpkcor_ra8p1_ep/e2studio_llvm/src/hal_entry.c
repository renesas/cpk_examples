#include "console.h"
#include "hal_data.h"
#include "sd.h"

#include "perf_counter/perf_counter.h"
#include "SEGGER_RTT/SEGGER_RTT.h"
#include "test/test.h"
#include "utils/log.h"

#if (1 == BSP_MULTICORE_PROJECT) && BSP_TZ_SECURE_BUILD
bsp_ipc_semaphore_handle_t g_core_start_semaphore =
{
    .semaphore_num = 0
};
#endif

/*******************************************************************************************************************//**
 * main() is generated by the RA Configuration editor and is used to generate threads if an RTOS is used.  This function
 * is called by main() when no RTOS is used.
 **********************************************************************************************************************/
void hal_entry(void)
{
	/* TODO: add your own code here */
	uint32_t i;
	uint32_t err;

	perfc_init(false);
#if CONSOLE_CFG_USE_RTT == 0
	SEGGER_RTT_Init();
#endif
	CONSOLE_Init();

	/* Clean screen */
#if CONSOLE_CFG_USE_RTT
    puts(RTT_CTRL_RESET);
    puts(RTT_CTRL_CLEAR);
#else
    puts("\x1b[2J\x1b[H");
    puts("\x1B[0m");
#endif

    SD_Init();

	/* Wake up 2nd core if this is first core and we are inside a multicore project. */
#if (0 == _RA_CORE) && (1 == BSP_MULTICORE_PROJECT) && !BSP_TZ_NONSECURE_BUILD

#if BSP_TZ_SECURE_BUILD
    /* Take semaphore so 2nd core can clear it */
    R_BSP_IpcSemaphoreTake(&g_core_start_semaphore);
#endif

    R_BSP_SecondaryCoreStart();

#if BSP_TZ_SECURE_BUILD
    /* Wait for 2nd core to start and clear semaphore */
    while(FSP_ERR_IN_USE == R_BSP_IpcSemaphoreTake(&g_core_start_semaphore))
    {
        ;
    }
#endif
#endif

#if (1 == _RA_CORE) && (1 == BSP_MULTICORE_PROJECT) && BSP_TZ_SECURE_BUILD
    /* Signal to 1st core that 2nd core has started */
    R_BSP_IpcSemaphoreGive(&g_core_start_semaphore);
#endif

    R_BSP_SoftwareDelay(500, BSP_DELAY_UNITS_MILLISECONDS);
    if (SD_IsInsert() == 0) {
    	printf("Wait SD Card insert");
    	R_BSP_SoftwareDelay(1, BSP_DELAY_UNITS_SECONDS);
    	while (SD_IsInsert() == 0) {
    		printf(".");
    		R_BSP_SoftwareDelay(1, BSP_DELAY_UNITS_SECONDS);
    	}
    }
    printf("\r\nDetect SD Card insert\r\n");

    err = SD_InitMedia();
    printf("Media Init: %u\r\n", err);
    TestSD();

    while (1) {
		R_IOPORT_PinWrite(g_ioport.p_ctrl, USER_LED, BSP_IO_LEVEL_HIGH);
		for (i = 0; i < 500; i++) {
			R_BSP_SoftwareDelay(1, BSP_DELAY_UNITS_MILLISECONDS);
			if (SD_IsInsertRemoveExist()) {
				if (SD_IsInsert()) {
					LOG_D(__FUNCTION__, "Inserted");
				}
				else {
					LOG_D(__FUNCTION__, "Removed");
				}
			}
		}
		R_IOPORT_PinWrite(g_ioport.p_ctrl, USER_LED, BSP_IO_LEVEL_LOW);
		for (i = 0; i < 500; i++) {
			R_BSP_SoftwareDelay(1, BSP_DELAY_UNITS_MILLISECONDS);
			if (SD_IsInsertRemoveExist()) {
				if (SD_IsInsert()) {
					LOG_D(__FUNCTION__, "Inserted");
				}
				else {
					LOG_D(__FUNCTION__, "Removed");
				}
			}
		}
	}

#if BSP_TZ_SECURE_BUILD
    /* Enter non-secure code */
    R_BSP_NonSecureEnter();
#endif
}

#if BSP_TZ_SECURE_BUILD

FSP_CPP_HEADER
BSP_CMSE_NONSECURE_ENTRY void template_nonsecure_callable ();

/* Trustzone Secure Projects require at least one nonsecure callable function in order to build (Remove this if it is not required to build). */
BSP_CMSE_NONSECURE_ENTRY void template_nonsecure_callable ()
{

}
FSP_CPP_FOOTER

#endif

#if LOG_CFG_EN_TIMESTAMP
void LOG_GetTime(uint32_t *s, uint32_t *ms)
{
	int64_t t = get_system_ms();
	*s = (uint32_t)(t / 1000);
	*ms = (uint32_t)(t % 1000);
}
#endif

void EXTERNAL_IRQ_Callback(external_irq_callback_args_t *p_args)
{
	bsp_io_level_t level;

	if (p_args->channel == g_external_irq29_cfg.channel) {
		R_IOPORT_PinRead(g_ioport.p_ctrl, BSP_IO_PORT_08_PIN_02, &level);
		if (level == BSP_IO_LEVEL_HIGH) {
			R_IOPORT_PinWrite(g_ioport.p_ctrl, BSP_IO_PORT_08_PIN_02, BSP_IO_LEVEL_LOW);
		}
		else {
			R_IOPORT_PinWrite(g_ioport.p_ctrl, BSP_IO_PORT_08_PIN_02, BSP_IO_LEVEL_HIGH);
		}
	}
}
