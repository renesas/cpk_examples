#include <inttypes.h>
#include <stdio.h>
#include "console.h"
#include "hal_data.h"
#include "iic.h"

#include "fusb303b/fusb303b.h"
#include "perf_counter/perf_counter.h"
#include "SEGGER_RTT/SEGGER_RTT.h"
#include "utils/log.h"

#define OPTION_INFO			"Input 1 to start write speed test\r\n" \
							"Input 2 to start read speed test\r\n"

#define RECEIVE_BUF_SIZE	8

#define USB_PACK_SIZE		512
#define USB_TEST_BYTES		(1024 * 1024)
#define USB_PACK_CNT		(USB_TEST_BYTES / USB_PACK_SIZE)

#if (1 == BSP_MULTICORE_PROJECT) && BSP_TZ_SECURE_BUILD
bsp_ipc_semaphore_handle_t g_core_start_semaphore =
{
    .semaphore_num = 0
};
#endif

static uint8_t s_receive_buf[RECEIVE_BUF_SIZE];
static uint8_t s_usb_attach;
static uint8_t s_usb_pack_buf[USB_PACK_SIZE];
static uint8_t s_usb_ready;
static uint8_t s_usb_receive_buf[RECEIVE_BUF_SIZE];
static uint8_t s_usb_write_done;
static volatile uint8_t s_irq_flag;
static volatile uint32_t s_time_cnt;
static usb_pcdc_linecoding_t s_line_coding;

static void read_speed_test(void);
static void wait_usb_attach(void);
static void write_speed_test(void);

/*******************************************************************************************************************//**
 * main() is generated by the RA Configuration editor and is used to generate threads if an RTOS is used.  This function
 * is called by main() when no RTOS is used.
 **********************************************************************************************************************/
void hal_entry(void)
{
	/* TODO: add your own code here */
	FUSB303_Status fusb_status;
	usb_event_info_t usb_event;
	usb_status_t usb_status;

	perfc_init(false);
#if CONSOLE_CFG_USE_RTT == 0
	SEGGER_RTT_Init();
#endif
	CONSOLE_Init();

	/* Clean screen */
#if CONSOLE_CFG_USE_RTT
    puts(RTT_CTRL_RESET);
    puts(RTT_CTRL_CLEAR);
#else
    puts("\x1b[2J\x1b[H");
    puts("\x1B[0m");
#endif
    printf("FSP Version: %s\r\n", FSP_VERSION_STRING);

    IIC_Init();
    FUSB303B_Init();
    R_ICU_ExternalIrqOpen(g_external_irq24.p_ctrl, g_external_irq24.p_cfg);
	R_ICU_ExternalIrqEnable(g_external_irq24.p_ctrl);
	R_GPT_Open(g_timer0.p_ctrl, g_timer0.p_cfg);
    R_GPT_Start(g_timer0.p_ctrl);

    wait_usb_attach();
    s_time_cnt = 0;
    R_USB_Open(g_basic0.p_ctrl, g_basic0.p_cfg);

	/* Wake up 2nd core if this is first core and we are inside a multicore project. */
#if (0 == _RA_CORE) && (1 == BSP_MULTICORE_PROJECT) && !BSP_TZ_NONSECURE_BUILD

#if BSP_TZ_SECURE_BUILD
    /* Take semaphore so 2nd core can clear it */
    R_BSP_IpcSemaphoreTake(&g_core_start_semaphore);
#endif

    R_BSP_SecondaryCoreStart();

#if BSP_TZ_SECURE_BUILD
    /* Wait for 2nd core to start and clear semaphore */
    while(FSP_ERR_IN_USE == R_BSP_IpcSemaphoreTake(&g_core_start_semaphore))
    {
        ;
    }
#endif
#endif

#if (1 == _RA_CORE) && (1 == BSP_MULTICORE_PROJECT) && BSP_TZ_SECURE_BUILD
    /* Signal to 1st core that 2nd core has started */
    R_BSP_IpcSemaphoreGive(&g_core_start_semaphore);
#endif

    printf(OPTION_INFO);

    while (1) {
    	R_USB_EventGet(&usb_event, &usb_status);
    	switch (usb_status) {
    	case USB_STATUS_POWERED:
    		break;
    	case USB_STATUS_DEFAULT:
    		break;
    	case USB_STATUS_ADDRESS:
    		break;
    	case USB_STATUS_CONFIGURED:
    		// R_USB_Read(g_basic0.p_ctrl, s_usb_receive_buf, RECEIVE_BUF_SIZE, USB_CLASS_PCDC);
    		s_usb_attach = 1;
    		s_usb_ready = 1;
    		break;
    	case USB_STATUS_SUSPEND:
    		s_usb_attach = 0;
    		memset(s_usb_receive_buf, 0, RECEIVE_BUF_SIZE);
    		break;
    	case USB_STATUS_RESUME:
    		s_usb_attach = 1;
    		break;
    	case USB_STATUS_DETACH:
    		s_usb_attach = 0;
    		memset(s_usb_receive_buf, 0, RECEIVE_BUF_SIZE);
    		break;
    	case USB_STATUS_REQUEST:
    		if ((usb_event.setup.request_type & USB_BREQUEST) == USB_PCDC_SET_LINE_CODING) {
    			R_USB_PeriControlDataGet(g_basic0.p_ctrl, (uint8_t *)&s_line_coding, 0x07);
    		}
    		else if ((usb_event.setup.request_type & USB_BREQUEST) == USB_PCDC_GET_LINE_CODING) {
    			R_USB_PeriControlDataSet(g_basic0.p_ctrl, (uint8_t *)&s_line_coding, 0x07);
    		}
    		else if ((usb_event.setup.request_type & USB_BREQUEST) == USB_PCDC_SET_CONTROL_LINE_STATE) {
    			R_USB_PeriControlStatusSet(g_basic0.p_ctrl, USB_SETUP_STATUS_ACK);
    		}
    		break;
    	case USB_STATUS_REQUEST_COMPLETE:
    		break;
    	case USB_STATUS_READ_COMPLETE:
    		if (s_usb_attach) {
    			// R_USB_Read(g_basic0.p_ctrl, s_usb_receive_buf, RECEIVE_BUF_SIZE, USB_CLASS_PCDC);
    		}
    		break;
    	case USB_STATUS_WRITE_COMPLETE:
    		s_usb_write_done = 1;
    		break;
    	case USB_STATUS_BC:
    		break;
    	case USB_STATUS_OVERCURRENT:
    		break;
    	case USB_STATUS_NOT_SUPPORT:
    		break;
    	case USB_STATUS_NONE:
    		break;
    	case USB_STATUS_MSC_CMD_COMPLETE:
    		break;
    	default:
    		break;
    	}

    	if (CONSOLE_HasData()) {
    		CONSOLE_Read(s_receive_buf, RECEIVE_BUF_SIZE);
    		if (s_receive_buf[0] == '1') {
    			printf("Start write speed test\r\n");
    			printf("Total bytes: %" PRIu32 "\r\n", USB_TEST_BYTES);
    			R_GPT_Stop(g_timer0.p_ctrl);
    			write_speed_test();
    			s_time_cnt = 0;
    			R_GPT_Start(g_timer0.p_ctrl);
    		}
    		else if (s_receive_buf[0] == '2') {
    			printf("Start read speed test\r\n");
    			printf("Total bytes: %" PRIu32 "\r\n", USB_TEST_BYTES);
    			R_GPT_Stop(g_timer0.p_ctrl);
    			read_speed_test();
    			s_time_cnt = 0;
    			R_GPT_Start(g_timer0.p_ctrl);
    		}
    		else {
    			printf("Bad option\r\n");
    		}

    		while (CONSOLE_HasData()) {
    			CONSOLE_Read(s_receive_buf, RECEIVE_BUF_SIZE);
    		}
    		memset(s_receive_buf, 0, RECEIVE_BUF_SIZE);
    	}

    	if (s_time_cnt > 15000) {
    		s_time_cnt = 0;
    		printf(OPTION_INFO);
    	}

    	if (s_irq_flag) {
    		FUSB303B_Check(&fusb_status);
    		if (fusb_status.attached == 0) {
    			printf("USB unattach\r\n");
    			wait_usb_attach();
    			s_time_cnt = 0;
    			printf(OPTION_INFO);
    		}
    	}
    }

#if BSP_TZ_SECURE_BUILD
    /* Enter non-secure code */
    R_BSP_NonSecureEnter();
#endif
}

#if BSP_TZ_SECURE_BUILD

FSP_CPP_HEADER
BSP_CMSE_NONSECURE_ENTRY void template_nonsecure_callable ();

/* Trustzone Secure Projects require at least one nonsecure callable function in order to build (Remove this if it is not required to build). */
BSP_CMSE_NONSECURE_ENTRY void template_nonsecure_callable ()
{

}
FSP_CPP_FOOTER

#endif

#if LOG_CFG_EN_TIMESTAMP
void LOG_GetTime(uint32_t *s, uint32_t *ms)
{
	int64_t t = get_system_ms();
	*s = (uint32_t)(t / 1000);
	*ms = (uint32_t)(t % 1000);
}
#endif

void ExternalIRQ_Callback(external_irq_callback_args_t *p_args)
{
	if (p_args->channel == 24) {
		s_irq_flag = 1;
	}
}

void Timer0_Callback(timer_callback_args_t *p_args)
{
	if (p_args->event == TIMER_EVENT_CYCLE_END) {
		s_time_cnt++;
	}
}

static void read_speed_test(void)
{
	float speed;
	int64_t time_start, time_end;
	usb_status_t usb_status;
	usb_event_info_t usb_event;

	uint8_t first = 1;
	uint8_t read_done = 0;
	uint32_t rec_len = 0;

	printf("Please input %" PRIu32 " bytes from USB terminal\r\n", USB_TEST_BYTES);
	while (rec_len < USB_TEST_BYTES) {
		read_done = 0;
		R_USB_Read(g_basic0.p_ctrl, s_usb_pack_buf, USB_PACK_SIZE, USB_CLASS_PCDC);
		while (read_done == 0) {
			R_USB_EventGet(&usb_event, &usb_status);
			switch (usb_status) {
			case USB_STATUS_READ_COMPLETE:
				read_done = 1;
				break;
			case USB_STATUS_REQUEST:
				if ((usb_event.setup.request_type & USB_BREQUEST) == USB_PCDC_SET_LINE_CODING) {
    			R_USB_PeriControlDataGet(g_basic0.p_ctrl, (uint8_t *)&s_line_coding, 0x07);
				}
				else if ((usb_event.setup.request_type & USB_BREQUEST) == USB_PCDC_GET_LINE_CODING) {
					R_USB_PeriControlDataSet(g_basic0.p_ctrl, (uint8_t *)&s_line_coding, 0x07);
				}
				else if ((usb_event.setup.request_type & USB_BREQUEST) == USB_PCDC_SET_CONTROL_LINE_STATE) {
					R_USB_PeriControlStatusSet(g_basic0.p_ctrl, USB_SETUP_STATUS_ACK);
				}
				break;
			default:
				break;
			}
		}
		if (first) {
			first = 0;
			time_start = get_system_ms();
		}
		rec_len += usb_event.data_size;
	}
	time_end = get_system_ms();
	if (time_end != time_start) {
		speed = (float)USB_TEST_BYTES / (float)(time_end - time_start) / 1024.0f * 1000.0f;
		printf("Read using time: %" PRId64 "ms, speed: %.2f KB/s\r\n", time_end - time_start, speed);
	}
	else {
		printf("USB_TEST_BYTES is too small\r\n");
	}
}

static void wait_usb_attach(void)
{
	FUSB303_Status status;

	printf("Wait USB attach as a sink...\r\n");

	FUSB303B_Check(&status);
	while (status.type != DETECT_TYPE_SINK) {
		if (s_irq_flag) {
			s_irq_flag = 0;
			FUSB303B_Check(&status);
		}
		if (s_time_cnt > 5000) {
			s_time_cnt = 0;
			printf("Wait USB attach as a sink...\r\n");
		}
	}

	printf("USB attach and as a sink\r\n");
}

static void write_speed_test(void)
{
	uint32_t i;
	float speed;
	int64_t time_start, time_end;
	usb_status_t usb_status;
	usb_event_info_t usb_event;

	memset(s_usb_pack_buf, 't', USB_PACK_SIZE);
	s_usb_pack_buf[USB_PACK_SIZE - 2] = '\r';
	s_usb_pack_buf[USB_PACK_SIZE - 1] = '\n';

	time_start = get_system_ms();
	for (i = 0; i < USB_PACK_CNT; i++) {
		R_USB_Write(g_basic0.p_ctrl, s_usb_pack_buf, USB_PACK_SIZE, USB_CLASS_PCDC);
		do {
			R_USB_EventGet(&usb_event, &usb_status);
			R_BSP_SoftwareDelay(1, BSP_DELAY_UNITS_MICROSECONDS);
		} while (usb_status != USB_STATUS_WRITE_COMPLETE);
	}
	time_end = get_system_ms();

	if (time_end != time_start) {
		speed = (float)USB_TEST_BYTES / (float)(time_end - time_start) / 1024.0f * 1000.0f;
		printf("Write using time: %" PRId64 "ms, speed: %.2f KB/s\r\n", time_end - time_start, speed);
	}
	else {
		printf("USB_TEST_BYTES is too small\r\n");
	}
}
