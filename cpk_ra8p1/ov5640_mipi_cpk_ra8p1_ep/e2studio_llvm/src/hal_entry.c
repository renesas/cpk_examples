#include <stdio.h>
#include "console.h"
#include "hal_data.h"
#include "iic.h"

#include "camera/camera.h"
#include "SEGGER_RTT/SEGGER_RTT.h"
#include "utils/log.h"

#if (1 == BSP_MULTICORE_PROJECT) && BSP_TZ_SECURE_BUILD
bsp_ipc_semaphore_handle_t g_core_start_semaphore =
{
    .semaphore_num = 0
};
#endif

static Camera s_camera_ov5640_mipi;

/*******************************************************************************************************************//**
 * main() is generated by the RA Configuration editor and is used to generate threads if an RTOS is used.  This function
 * is called by main() when no RTOS is used.
 **********************************************************************************************************************/
void hal_entry(void)
{
	/* TODO: add your own code here */
	uint32_t ret;
	CameraConfig ov5640_config_mipi;

	uint8_t capture_cnt = 0;

#if CONSOLE_CFG_USE_RTT == 0
    SEGGER_RTT_Init();
#endif
    CONSOLE_Init();
    LOG_Reset();

    /* Clean screen */
#if CONSOLE_CFG_USE_RTT
    puts(RTT_CTRL_RESET);
    puts(RTT_CTRL_CLEAR);
#else
    puts("\x1b[2J\x1b[H");
    puts("\x1B[0m");
#endif

    IIC_Init();

    ov5640_config_mipi.model = CAMERA_MODEL_OV5640;
    ov5640_config_mipi.interface = CAMERA_INTERFACE_MIPI_CSI;
    ov5640_config_mipi.length = 1024;
    ov5640_config_mipi.width = 600;
    ov5640_config_mipi.peripheral_inst = &g_vin_ov5640;
    CameraInit(&s_camera_ov5640_mipi, &ov5640_config_mipi);
    CameraStartCapture(&s_camera_ov5640_mipi, NULL);

	/* Wake up 2nd core if this is first core and we are inside a multicore project. */
#if (0 == _RA_CORE) && (1 == BSP_MULTICORE_PROJECT) && !BSP_TZ_NONSECURE_BUILD

#if BSP_TZ_SECURE_BUILD
    /* Take semaphore so 2nd core can clear it */
    R_BSP_IpcSemaphoreTake(&g_core_start_semaphore);
#endif

    R_BSP_SecondaryCoreStart();

#if BSP_TZ_SECURE_BUILD
    /* Wait for 2nd core to start and clear semaphore */
    while(FSP_ERR_IN_USE == R_BSP_IpcSemaphoreTake(&g_core_start_semaphore))
    {
        ;
    }
#endif
#endif

#if (1 == _RA_CORE) && (1 == BSP_MULTICORE_PROJECT) && BSP_TZ_SECURE_BUILD
    /* Signal to 1st core that 2nd core has started */
    R_BSP_IpcSemaphoreGive(&g_core_start_semaphore);
#endif

    ret = CameraIsCaptureDone(&s_camera_ov5640_mipi);
    while (capture_cnt < 1) {
    	while (ret == 0) {
    		R_BSP_SoftwareDelay(10, BSP_DELAY_UNITS_MILLISECONDS);
    		ret = CameraIsCaptureDone(&s_camera_ov5640_mipi);
    	}
    	capture_cnt++;
    }

    if (s_camera_ov5640_mipi.image_ready == vin_image_buffer_1) {
    	puts("Check vin_image_buffer_1 for OV5640 MIPI CSI interface");
    }
    else if (s_camera_ov5640_mipi.image_ready == vin_image_buffer_2) {
    	puts("Check vin_image_buffer_2 for OV5640 MIPI CSI interface");
    }
    else if (s_camera_ov5640_mipi.image_ready == vin_image_buffer_3) {
    	puts("Check vin_image_buffer_3 for OV5640 MIPI CSI interface");
    }
    else {
    	puts("Check vin buffer error for OV5640 MIPI CSI interface");
    }

    __BKPT(0);

#if BSP_TZ_SECURE_BUILD
    /* Enter non-secure code */
    R_BSP_NonSecureEnter();
#endif
}

#if BSP_TZ_SECURE_BUILD

FSP_CPP_HEADER
BSP_CMSE_NONSECURE_ENTRY void template_nonsecure_callable ();

/* Trustzone Secure Projects require at least one nonsecure callable function in order to build (Remove this if it is not required to build). */
BSP_CMSE_NONSECURE_ENTRY void template_nonsecure_callable ()
{

}
FSP_CPP_FOOTER

#endif
