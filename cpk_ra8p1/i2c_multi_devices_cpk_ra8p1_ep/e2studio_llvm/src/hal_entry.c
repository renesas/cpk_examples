#include "console.h"
#include "hal_data.h"
#include "i2c_comms.h"
#include "mmc5603.h"

#include "imu/inv_imu_driver.h"
#include "perf_counter/perf_counter.h"
#include "SEGGER_RTT/SEGGER_RTT.h"
#include "utils/log.h"

#define UNLIKE_RETURN(v, t, msg, ...)	if (v != t) { LOG_E(__FUNCTION__, msg, ##__VA_ARGS__); return v; }

#if (1 == BSP_MULTICORE_PROJECT) && BSP_TZ_SECURE_BUILD
bsp_ipc_semaphore_handle_t g_core_start_semaphore =
{
    .semaphore_num = 0
};
#endif

static bool s_time_500ms;
static bool s_time_1s;
static bool s_fifo_irq;
static int s_odr_freq;
static inv_imu_device_t s_imu_device;
static inv_imu_serif_t s_imu_serif;

static void imuCallback(inv_imu_sensor_event_t *event);
static uint32_t imuConfig(inv_imu_device_t *icm_dev);
static int imuReadReg(struct inv_imu_serif *serif, uint8_t reg, uint8_t *buf, uint32_t len);
static int imuWriteReg(struct inv_imu_serif *serif, uint8_t reg, const uint8_t *buf, uint32_t len);

/*******************************************************************************************************************//**
 * main() is generated by the RA Configuration editor and is used to generate threads if an RTOS is used.  This function
 * is called by main() when no RTOS is used.
 **********************************************************************************************************************/
void hal_entry(void)
{
	/* TODO: add your own code here */
	int32_t x, y, z;
	bsp_io_level_t level;

	perfc_init(false);
#if CONSOLE_CFG_USE_RTT == 0
	SEGGER_RTT_Init();
#endif
	CONSOLE_Init();

	/* Clean screen */
#if CONSOLE_CFG_USE_RTT
    puts(RTT_CTRL_RESET);
    puts(RTT_CTRL_CLEAR);
#else
    puts("\x1b[2J\x1b[H");
    puts("\x1B[0m");
#endif
    printf("FSP Version: %s\r\n", FSP_VERSION_STRING);

    I2C_COMMS_Init(&g_i2c_dev_mmc5603);
    I2C_COMMS_Init(&g_i2c_dev_icm42670);

    MMC5603_Init();

    R_ICU_ExternalIrqOpen(g_external_irq31.p_ctrl, g_external_irq31.p_cfg);
    s_imu_serif.read_reg = imuReadReg;
	s_imu_serif.write_reg = imuWriteReg;
	s_imu_serif.max_read = 126;
	s_imu_serif.max_write = 126;
	s_imu_serif.serif_type = UI_I2C;
	s_imu_serif.context = NULL;
	inv_imu_init(&s_imu_device, &s_imu_serif, imuCallback);
	imuConfig(&s_imu_device);

	uint32_t err;
	err = R_GPT_Open(g_timer0.p_ctrl, g_timer0.p_cfg);
	if (err) printf("GPT_Open failed: %u", err);
	err = R_GPT_Start(g_timer0.p_ctrl);
	if (err) printf("GPT_Start failed: %u", err);

	/* Wake up 2nd core if this is first core and we are inside a multicore project. */
#if (0 == _RA_CORE) && (1 == BSP_MULTICORE_PROJECT) && !BSP_TZ_NONSECURE_BUILD

#if BSP_TZ_SECURE_BUILD
    /* Take semaphore so 2nd core can clear it */
    R_BSP_IpcSemaphoreTake(&g_core_start_semaphore);
#endif

    R_BSP_SecondaryCoreStart();

#if BSP_TZ_SECURE_BUILD
    /* Wait for 2nd core to start and clear semaphore */
    while(FSP_ERR_IN_USE == R_BSP_IpcSemaphoreTake(&g_core_start_semaphore))
    {
        ;
    }
#endif
#endif

#if (1 == _RA_CORE) && (1 == BSP_MULTICORE_PROJECT) && BSP_TZ_SECURE_BUILD
    /* Signal to 1st core that 2nd core has started */
    R_BSP_IpcSemaphoreGive(&g_core_start_semaphore);
#endif

    while (1) {
    	R_BSP_SoftwareDelay(1, BSP_DELAY_UNITS_MILLISECONDS);
    	if (s_time_500ms) {
    		s_time_500ms = false;
    		R_IOPORT_PinRead(g_ioport.p_ctrl, USER_LED, &level);
    		if (level == BSP_IO_LEVEL_HIGH) {
    			R_IOPORT_PinWrite(g_ioport.p_ctrl, USER_LED, BSP_IO_LEVEL_LOW);
    		}
    		else {
    			R_IOPORT_PinWrite(g_ioport.p_ctrl, USER_LED, BSP_IO_LEVEL_HIGH);
    		}
    	}

    	if (s_time_1s) {
    		s_time_1s = false;
			MMC5603_GetXYZ(&x, &y, &z);
			printf("\r\n============== MMC5603 ==============\r\n");
			printf("x: %d, y: %d, z: %d\r\n", x, y, z);
			printf("=====================================\r\n");
    	}

		if (s_fifo_irq) {
			s_fifo_irq = false;
			inv_imu_get_data_from_fifo(&s_imu_device);
		}
    }

#if BSP_TZ_SECURE_BUILD
    /* Enter non-secure code */
    R_BSP_NonSecureEnter();
#endif
}

#if BSP_TZ_SECURE_BUILD

FSP_CPP_HEADER
BSP_CMSE_NONSECURE_ENTRY void template_nonsecure_callable ();

/* Trustzone Secure Projects require at least one nonsecure callable function in order to build (Remove this if it is not required to build). */
BSP_CMSE_NONSECURE_ENTRY void template_nonsecure_callable ()
{

}
FSP_CPP_FOOTER

#endif

#if LOG_CFG_EN_TIMESTAMP
void LOG_GetTime(uint32_t *s, uint32_t *ms)
{
	int64_t t = get_system_ms();
	*s = (uint32_t)(t / 1000);
	*ms = (uint32_t)(t % 1000);
}
#endif

void ExternalIRQ31_Callback(external_irq_callback_args_t *p_args)
{
	(void)p_args;

	s_fifo_irq = true;
}

void TIMER0_Callback(timer_callback_args_t *p_args)
{
	static uint32_t cnt = 0;

	if (p_args->event == TIMER_EVENT_CYCLE_END) {
		cnt++;
		if ((cnt % 5) == 0) {
			s_time_500ms = true;
		}
		if ((cnt % 10) == 0) {
			s_time_1s = true;
		}
		if (cnt == 0xF0000000) {
			cnt = 0;
		}
	}
}

uint64_t inv_imu_get_time_us(void)
{
	return (uint64_t)get_system_us();
}

void inv_imu_sleep_us(uint32_t us)
{
	R_BSP_SoftwareDelay(us, BSP_DELAY_UNITS_MICROSECONDS);
}

static void imuCallback(inv_imu_sensor_event_t *event)
{
	static int cnt = 0;
	static int accel[3];
	static int gyro[3];
	static int temperature;

	int i;
	double accel_g[3];
	double accel_ms2[3];
	double gyro_dps[3];
	double gyro_rads[3];
	double tempe;

	const double accel_scale_g = 4.0 / 32768.0;
	const double gyro_scale_dps = 2000.0 / 32768.0;
	const double gravity_ms2 = 9.80665;
	const double deg_to_rag = 0.01745329252;

	cnt++;
	for (i = 0; i < 3; i++) {
		accel[i] += event->accel[i];
		gyro[i] += event->gyro[i];
	}
	temperature += event->temperature;

	if (cnt == s_odr_freq) {
		cnt = 0;

		printf("\r\n============= IMU42670 ==============\r\n");
		printf("Original data: 50 times average\r\n");
		for (i = 0; i < 3; i++) {
			accel[i] = accel[i] / s_odr_freq;
			gyro[i] = gyro[i] / s_odr_freq;
		}
		temperature = temperature / s_odr_freq;
		printf("Acceleration: X = %d, Y = %d, Z = %d\r\n", accel[0], accel[1], accel[2]);
		printf("Gyroscope:    X = %d, Y = %d, Z = %d\r\n", gyro[0], gyro[1], gyro[2]);
		printf("Sensor Temperature: %d\r\n", temperature);

		printf("Conversion data:\r\n");
		for (i = 0; i < 3; i++) {
			accel_g[i] = (double)accel[i] * accel_scale_g;
			accel_ms2[i] = (double)accel_g[i] * gravity_ms2;
			gyro_dps[i] = (double)gyro[i] * gyro_scale_dps;
			gyro_rads[i] = (double)gyro_dps[i] * deg_to_rag;
		}
		tempe = 25.0 + (double)temperature / 2.0;
		printf("Acceleration: X = %.4f, Y = %.4f, Z = %.4f m/s^2\r\n", accel_ms2[0], accel_ms2[1], accel_ms2[2]);
		printf("Gyroscope:    X = %.4f, Y = %.4f, Z = %.4f dps\r\n", gyro_dps[0], gyro_dps[1], gyro_dps[2]);
		printf("Gyroscope:    X = %.4f, Y = %.4f, Z = %.4f rad/s\r\n", gyro_rads[0], gyro_rads[1], gyro_rads[2]);
		printf("Sensor Temperature: %.4f ℃\r\n", tempe);

		memset(accel, 0x00, sizeof(accel));
		memset(gyro, 0x00, sizeof(gyro));
		temperature = 0;
		printf("====================================\r\n");
	}
}

static uint32_t imuConfig(inv_imu_device_t *icm_dev)
{
	int rc;
	uint32_t err;
	inv_imu_int1_pin_config_t int1_pin_cfg;
	inv_imu_interrupt_parameter_t int1_source;

	s_fifo_irq = false;

	memset(&int1_pin_cfg, 0x00, sizeof(int1_pin_cfg));
	int1_pin_cfg.int_drive = INT_CONFIG_INT1_DRIVE_CIRCUIT_OD;
	int1_pin_cfg.int_mode = INT_CONFIG_INT1_MODE_PULSED;
	int1_pin_cfg.int_polarity = INT_CONFIG_INT1_POLARITY_LOW;
	rc = inv_imu_set_pin_config_int1(icm_dev, &int1_pin_cfg);
	err = (uint32_t)rc;
	UNLIKE_RETURN(err, 0, "inv_imu_set_pin_config_int1() failed: %d", rc);

	memset(&int1_source, 0x00, sizeof(int1_source));
	int1_source.INV_UI_DRDY = INV_IMU_DISABLE;
	int1_source.INV_FIFO_THS = INV_IMU_ENABLE;
	rc = inv_imu_set_config_int1(icm_dev, &int1_source);
	err = (uint32_t)rc;
	UNLIKE_RETURN(err, 0, "inv_imu_set_config_int1() failed: %d", rc);

	rc = inv_imu_configure_fifo(icm_dev, INV_IMU_FIFO_ENABLED);
	err = (uint32_t)rc;
	UNLIKE_RETURN(err, 0, "inv_imu_configure_fifo() failed: %d", rc);
	rc = inv_imu_reset_fifo(icm_dev);
	err = (uint32_t)rc;
	UNLIKE_RETURN(err, 0, "inv_imu_reset_fifo() failed: %d", rc);
	rc = inv_imu_set_accel_fsr(icm_dev, ACCEL_CONFIG0_FS_SEL_4g);
	err = (uint32_t)rc;
	UNLIKE_RETURN(err, 0, "inv_imu_set_accel_fsr() failed: %d", rc);
	rc = inv_imu_set_gyro_fsr(icm_dev, GYRO_CONFIG0_FS_SEL_2000dps);
	err = (uint32_t)rc;
	UNLIKE_RETURN(err, 0, "inv_imu_set_gyro_fsr() failed: %d", rc);
	if (icm_dev->transport.serif.serif_type == UI_I2C) {
		s_odr_freq = 50;
		rc = inv_imu_set_accel_frequency(icm_dev, ACCEL_CONFIG0_ODR_50_HZ);
		err = (uint32_t)rc;
		UNLIKE_RETURN(err, 0, "inv_imu_set_accel_frequency() failed: %d", rc);
		rc = inv_imu_set_gyro_frequency(icm_dev, GYRO_CONFIG0_ODR_50_HZ);
		err = (uint32_t)rc;
		UNLIKE_RETURN(err, 0, "inv_imu_set_gyro_frequency() failed: %d", rc);
	}
	else {
		s_odr_freq = 50;
		rc = inv_imu_set_accel_frequency(icm_dev, ACCEL_CONFIG0_ODR_50_HZ);
		err = (uint32_t)rc;
		UNLIKE_RETURN(err, 0, "inv_imu_set_accel_frequency() failed: %d", rc);
		rc = inv_imu_set_gyro_frequency(icm_dev, GYRO_CONFIG0_ODR_50_HZ);
		err = (uint32_t)rc;
		UNLIKE_RETURN(err, 0, "inv_imu_set_gyro_frequency() failed: %d", rc);
	}
	rc = inv_imu_enable_accel_low_noise_mode(icm_dev);
	err = (uint32_t)rc;
	UNLIKE_RETURN(err, 0, "inv_imu_enable_accel_low_noise_mode() failed: %d", rc);
	rc = inv_imu_enable_gyro_low_noise_mode(icm_dev);
	err = (uint32_t)rc;
	UNLIKE_RETURN(err, 0, "inv_imu_enable_gyro_low_noise_mode() failed: %d", rc);

	rc = inv_imu_get_data_from_registers(icm_dev);
	err = (uint32_t)rc;
	UNLIKE_RETURN(err, 0, "inv_imu_get_data_from_registers() failed: %d", rc);

	R_ICU_ExternalIrqEnable(g_external_irq31.p_ctrl);

	return 0;
}

static int imuReadReg(struct inv_imu_serif *serif, uint8_t reg, uint8_t *buf, uint32_t len)
{
	uint32_t err;

	(void)serif;

	err = I2C_COMMS_ReadMem(&g_i2c_dev_icm42670, reg, 8, buf, (uint16_t)len);
	if (err) {
		LOG_E(__FUNCTION__, "IIC_ReadMemory failed: %u", err);
	}

	return (int)err;
}

static int imuWriteReg(struct inv_imu_serif *serif, uint8_t reg, const uint8_t *buf, uint32_t len)
{
	uint32_t err;

	(void)serif;

	err = I2C_COMMS_WriteMem(&g_i2c_dev_icm42670, reg, 8, buf, (uint16_t)len);
	if (err) {
		LOG_E(__FUNCTION__, "IIC_WriteMemory failed: %u", err);
	}

	return (int)err;
}
