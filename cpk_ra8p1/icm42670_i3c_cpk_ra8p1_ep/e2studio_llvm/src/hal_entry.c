#include "console.h"
#include "hal_data.h"
#include "i3c.h"
#include "iic.h"

#include "imu/inv_imu_driver.h"
#include "perf_counter/perf_counter.h"
#include "SEGGER_RTT/SEGGER_RTT.h"
#include "test/test.h"
#include "utils/log.h"

#define IMU_USING_I2C	1
#define IMU_USING_I3C	2

#define IMU_INTERFACE	IMU_USING_I3C

#if (1 == BSP_MULTICORE_PROJECT) && BSP_TZ_SECURE_BUILD
bsp_ipc_semaphore_handle_t g_core_start_semaphore =
{
    .semaphore_num = 0
};
#endif

static inv_imu_device_t s_imu_device;
static inv_imu_serif_t s_imu_serif;

static int imuReadReg(struct inv_imu_serif *serif, uint8_t reg, uint8_t *buf, uint32_t len);
static int imuWriteReg(struct inv_imu_serif *serif, uint8_t reg, const uint8_t *buf, uint32_t len);

/*******************************************************************************************************************//**
 * main() is generated by the RA Configuration editor and is used to generate threads if an RTOS is used.  This function
 * is called by main() when no RTOS is used.
 **********************************************************************************************************************/
void hal_entry(void)
{
	/* TODO: add your own code here */
	int rc;

	perfc_init(false);
#if CONSOLE_CFG_USE_RTT == 0
	SEGGER_RTT_Init();
#endif
	CONSOLE_Init();

	/* Clean screen */
#if CONSOLE_CFG_USE_RTT
    puts(RTT_CTRL_RESET);
    puts(RTT_CTRL_CLEAR);
#else
    puts("\x1b[2J\x1b[H");
    puts("\x1B[0m");
#endif
    printf("FSP Version: %s\r\n", FSP_VERSION_STRING);

#if IMU_INTERFACE == IMU_USING_I2C
    IIC_Init();
#else
    I3C_Init();
#endif
    R_ICU_ExternalIrqOpen(g_external_irq31.p_ctrl, g_external_irq31.p_cfg);

	s_imu_serif.read_reg = imuReadReg;
	s_imu_serif.write_reg = imuWriteReg;
	s_imu_serif.max_read = 126;
	s_imu_serif.max_write = 126;
#if IMU_INTERFACE == IMU_USING_I2C
	s_imu_serif.serif_type = UI_I2C;
#else
	s_imu_serif.serif_type = UI_I3C;
#endif
	s_imu_serif.context = NULL;
	rc = inv_imu_init(&s_imu_device, &s_imu_serif, TestICMCallback);

	/* Wake up 2nd core if this is first core and we are inside a multicore project. */
#if (0 == _RA_CORE) && (1 == BSP_MULTICORE_PROJECT) && !BSP_TZ_NONSECURE_BUILD

#if BSP_TZ_SECURE_BUILD
    /* Take semaphore so 2nd core can clear it */
    R_BSP_IpcSemaphoreTake(&g_core_start_semaphore);
#endif

    R_BSP_SecondaryCoreStart();

#if BSP_TZ_SECURE_BUILD
    /* Wait for 2nd core to start and clear semaphore */
    while(FSP_ERR_IN_USE == R_BSP_IpcSemaphoreTake(&g_core_start_semaphore))
    {
        ;
    }
#endif
#endif

#if (1 == _RA_CORE) && (1 == BSP_MULTICORE_PROJECT) && BSP_TZ_SECURE_BUILD
    /* Signal to 1st core that 2nd core has started */
    R_BSP_IpcSemaphoreGive(&g_core_start_semaphore);
#endif

    if (rc) {
    	LOG_E(__FUNCTION__, "IMU bus/driver initialization failed: %d", rc);
    }
    else {
    	TestICM42670(&s_imu_device);
    }

    while (1) {
		R_IOPORT_PinWrite(g_ioport.p_ctrl, USER_LED, BSP_IO_LEVEL_HIGH);
		R_BSP_SoftwareDelay(500, BSP_DELAY_UNITS_MILLISECONDS);
		R_IOPORT_PinWrite(g_ioport.p_ctrl, USER_LED, BSP_IO_LEVEL_LOW);
		R_BSP_SoftwareDelay(500, BSP_DELAY_UNITS_MILLISECONDS);
	}

#if BSP_TZ_SECURE_BUILD
    /* Enter non-secure code */
    R_BSP_NonSecureEnter();
#endif
}

#if BSP_TZ_SECURE_BUILD

FSP_CPP_HEADER
BSP_CMSE_NONSECURE_ENTRY void template_nonsecure_callable ();

/* Trustzone Secure Projects require at least one nonsecure callable function in order to build (Remove this if it is not required to build). */
BSP_CMSE_NONSECURE_ENTRY void template_nonsecure_callable ()
{

}
FSP_CPP_FOOTER

#endif

#if LOG_CFG_EN_TIMESTAMP
void LOG_GetTime(uint32_t *s, uint32_t *ms)
{
	int64_t t = get_system_ms();
	*s = (uint32_t)(t / 1000);
	*ms = (uint32_t)(t % 1000);
}
#endif

uint64_t inv_imu_get_time_us(void)
{
	return (uint64_t)get_system_us();
}

void inv_imu_sleep_us(uint32_t us)
{
	R_BSP_SoftwareDelay(us, BSP_DELAY_UNITS_MICROSECONDS);
}

static int imuReadReg(struct inv_imu_serif *serif, uint8_t reg, uint8_t *buf, uint32_t len)
{
	uint32_t err;

	(void)serif;

#if IMU_INTERFACE == IMU_USING_I2C
	err = IIC_ReadMemory(0x68, reg, 8, buf, (uint16_t)len);
	if (err) {
		LOG_E(__FUNCTION__, "IIC_ReadMemory failed: %u", err);
	}
#else
	err = I3C_ReadMemory(reg, buf, len);
	if (err) {
		LOG_E(__FUNCTION__, "I3C_ReadMemory failed: %u", err);
	}
#endif

	return (int)err;
}

static int imuWriteReg(struct inv_imu_serif *serif, uint8_t reg, const uint8_t *buf, uint32_t len)
{
	uint32_t err;

	(void)serif;

#if IMU_INTERFACE == IMU_USING_I2C
	err = IIC_WriteMemory(0x68, reg, 8, buf, (uint16_t)len);
	if (err) {
		LOG_E(__FUNCTION__, "IIC_WriteMemory failed: %u", err);
	}
#else
	err = I3C_WriteMemory(reg, buf, len);
	if (err) {
		LOG_E(__FUNCTION__, "I3C_WriteMemory failed: %u", err);
	}
#endif

	return (int)err;
}
