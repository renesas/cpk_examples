#include <stdio.h>
#include "console.h"
#include "hal_data.h"

#include "fusb303b/fusb303b.h"
#include "SEGGER_RTT/SEGGER_RTT.h"

#define FUSB303B_ROLE_DFP	0x01
#define FUSB303B_ROLE_DRP	0x02
#define FUSB303B_ROLE_UFP	0x03

#define FUSB303B_DEMO_ROLE	FUSB303B_ROLE_UFP

#if (1 == BSP_MULTICORE_PROJECT) && BSP_TZ_SECURE_BUILD
bsp_ipc_semaphore_handle_t g_core_start_semaphore =
{
    .semaphore_num = 0
};
#endif

static uint8_t s_irq_flag;
static const char *sc_type_string[8] = {
	"AUDIO",
	"AUDIOVBUS",
	"ACTIVECABLE",
	"SOURCE",
	"SINK",
	"DEBUGSNK",
	"DEBUGSRC",
	"UNKNOW"
};

/*******************************************************************************************************************//**
 * main() is generated by the RA Configuration editor and is used to generate threads if an RTOS is used.  This function
 * is called by main() when no RTOS is used.
 **********************************************************************************************************************/
void hal_entry(void)
{
	/* TODO: add your own code here */
	FUSB303_Status status;

	SEGGER_RTT_Init();
	CONSOLE_Init();

	R_IIC_MASTER_Open(g_i2c_master0.p_ctrl, g_i2c_master0.p_cfg);
	R_BSP_SoftwareDelay(100, BSP_DELAY_UNITS_MILLISECONDS);
	FUSB303B_Init();

	R_ICU_ExternalIrqOpen(g_external_irq24.p_ctrl, g_external_irq24.p_cfg);
	R_ICU_ExternalIrqEnable(g_external_irq24.p_ctrl);

	R_GPT_Open(g_timer0.p_ctrl, g_timer0.p_cfg);
	R_GPT_Start(g_timer0.p_ctrl);

	/* Wake up 2nd core if this is first core and we are inside a multicore project. */
#if (0 == _RA_CORE) && (1 == BSP_MULTICORE_PROJECT) && !BSP_TZ_NONSECURE_BUILD

#if BSP_TZ_SECURE_BUILD
    /* Take semaphore so 2nd core can clear it */
    R_BSP_IpcSemaphoreTake(&g_core_start_semaphore);
#endif

    R_BSP_SecondaryCoreStart();

#if BSP_TZ_SECURE_BUILD
    /* Wait for 2nd core to start and clear semaphore */
    while(FSP_ERR_IN_USE == R_BSP_IpcSemaphoreTake(&g_core_start_semaphore))
    {
        ;
    }
#endif
#endif

#if (1 == _RA_CORE) && (1 == BSP_MULTICORE_PROJECT) && BSP_TZ_SECURE_BUILD
    /* Signal to 1st core that 2nd core has started */
    R_BSP_IpcSemaphoreGive(&g_core_start_semaphore);
#endif

#if FUSB303B_DEMO_ROLE == FUSB303B_ROLE_DFP
    FUSB303B_SetAutoPortrole(AUTO_PORTROLE_ONLY_SRC, true);
#elif FUSB303B_DEMO_ROLE == FUSB303B_ROLE_UFP
    FUSB303B_SetAutoPortrole(AUTO_PORTROLE_ONLY_SNK, true);
#endif

    while (1) {
    	R_BSP_SoftwareDelay(1, BSP_DELAY_UNITS_MILLISECONDS);
    	if (s_irq_flag) {
    		FUSB303B_Check(&status);
    		s_irq_flag = 0;

    		if (status.attached) {
    			printf("Detected attached\r\n");
				if (status.type < 8) {
					printf("Type: %s\r\n", sc_type_string[status.type]);
				}
				else {
					printf("Error Type\r\n");
				}
    		}
    		else {
    			printf("Detected unattached\r\n");
    		#if FUSB303B_DEMO_ROLE == FUSB303B_ROLE_DFP
    			if (status.vbus_connect) {
    				printf("Seems like connect to a SOURCE but FUSB303B set as SOURCE too\r\n");
    			}
			#else
    			if (status.vbus_connect) {
    				printf("But VBUS connect, wait DRP process\r\n");
    			}
    		#endif
    		}
    	}
    }

#if BSP_TZ_SECURE_BUILD
    /* Enter non-secure code */
    R_BSP_NonSecureEnter();
#endif
}

#if BSP_TZ_SECURE_BUILD

FSP_CPP_HEADER
BSP_CMSE_NONSECURE_ENTRY void template_nonsecure_callable ();

/* Trustzone Secure Projects require at least one nonsecure callable function in order to build (Remove this if it is not required to build). */
BSP_CMSE_NONSECURE_ENTRY void template_nonsecure_callable ()
{

}
FSP_CPP_FOOTER

#endif

void ExternalIRQ_Callback(external_irq_callback_args_t *p_args)
{
	if (p_args->channel == 24) {
		s_irq_flag = 1;
	}
}

void TIMER0_Callback(timer_callback_args_t *p_args)
{
	bsp_io_level_t level;

	if (p_args->event == TIMER_EVENT_CYCLE_END) {
		R_IOPORT_PinRead(g_ioport.p_ctrl, USER_LED, &level);
		if (level == BSP_IO_LEVEL_HIGH) {
			R_IOPORT_PinWrite(g_ioport.p_ctrl, USER_LED, BSP_IO_LEVEL_LOW);
		}
		else {
			R_IOPORT_PinWrite(g_ioport.p_ctrl, USER_LED, BSP_IO_LEVEL_HIGH);
		}
	}
}
