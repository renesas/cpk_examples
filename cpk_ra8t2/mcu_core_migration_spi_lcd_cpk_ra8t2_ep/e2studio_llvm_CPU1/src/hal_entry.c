#include "console.h"
#include "hal_data.h"
#include "lcd.h"
#include "picture.h"

#if (1 == BSP_MULTICORE_PROJECT) && BSP_TZ_SECURE_BUILD
bsp_ipc_semaphore_handle_t g_core_start_semaphore =
{
    .semaphore_num = 0
};
#endif

static LCD_Device s_lcd;

/*******************************************************************************************************************//**
 * main() is generated by the RA Configuration editor and is used to generate threads if an RTOS is used.  This function
 * is called by main() when no RTOS is used.
 **********************************************************************************************************************/
void hal_entry(void)
{
	/* TODO: add your own code here */
	int i;

	CONSOLE_Init();

	s_lcd.orientation = SCREEN_ORIENTATION_VERTICAL;
	LCD_Init(&s_lcd);

	/* Wake up 2nd core if this is first core and we are inside a multicore project. */
#if (0 == _RA_CORE) && (1 == BSP_MULTICORE_PROJECT) && !BSP_TZ_NONSECURE_BUILD

#if BSP_TZ_SECURE_BUILD
    /* Take semaphore so 2nd core can clear it */
    R_BSP_IpcSemaphoreTake(&g_core_start_semaphore);
#endif

    R_BSP_SecondaryCoreStart();

#if BSP_TZ_SECURE_BUILD
    /* Wait for 2nd core to start and clear semaphore */
    while(FSP_ERR_IN_USE == R_BSP_IpcSemaphoreTake(&g_core_start_semaphore))
    {
        ;
    }
#endif
#endif

#if (1 == _RA_CORE) && (1 == BSP_MULTICORE_PROJECT) && BSP_TZ_SECURE_BUILD
    /* Signal to 1st core that 2nd core has started */
    R_BSP_IpcSemaphoreGive(&g_core_start_semaphore);
#endif

    LCD_PortDrawBitmap(&s_lcd, 0, 0, 222, 480, (const uint8_t *)g_picture01.pixel_data);
    while (1) {
    	for (i = 0; i < 5; i++) {
			R_IOPORT_PinWrite(g_ioport.p_ctrl, USER_LED, BSP_IO_LEVEL_HIGH);
			R_BSP_SoftwareDelay(500, BSP_DELAY_UNITS_MILLISECONDS);
			R_IOPORT_PinWrite(g_ioport.p_ctrl, USER_LED, BSP_IO_LEVEL_LOW);
			R_BSP_SoftwareDelay(500, BSP_DELAY_UNITS_MILLISECONDS);
    	}
    	LCD_PortDrawBitmap(&s_lcd, 0, 0, 222, 480, (const uint8_t *)g_picture02.pixel_data);

    	for (i = 0; i < 5; i++) {
			R_IOPORT_PinWrite(g_ioport.p_ctrl, USER_LED, BSP_IO_LEVEL_HIGH);
			R_BSP_SoftwareDelay(500, BSP_DELAY_UNITS_MILLISECONDS);
			R_IOPORT_PinWrite(g_ioport.p_ctrl, USER_LED, BSP_IO_LEVEL_LOW);
			R_BSP_SoftwareDelay(500, BSP_DELAY_UNITS_MILLISECONDS);
    	}
    	LCD_PortDrawBitmap(&s_lcd, 0, 0, 222, 480, (const uint8_t *)g_picture01.pixel_data);
    }

#if BSP_TZ_SECURE_BUILD
    /* Enter non-secure code */
    R_BSP_NonSecureEnter();
#endif
}

#if BSP_TZ_SECURE_BUILD

FSP_CPP_HEADER
BSP_CMSE_NONSECURE_ENTRY void template_nonsecure_callable ();

/* Trustzone Secure Projects require at least one nonsecure callable function in order to build (Remove this if it is not required to build). */
BSP_CMSE_NONSECURE_ENTRY void template_nonsecure_callable ()
{

}
FSP_CPP_FOOTER

#endif
