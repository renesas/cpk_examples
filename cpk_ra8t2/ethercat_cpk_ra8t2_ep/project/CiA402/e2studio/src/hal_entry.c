#include <stdio.h>
#include "hal_data.h"
#include "applInterface.h"
#include "samplecia402.h"

#if (1 == BSP_MULTICORE_PROJECT) && BSP_TZ_SECURE_BUILD
bsp_ipc_semaphore_handle_t g_core_start_semaphore =
{
    .semaphore_num = 0
};
#endif

void handle_error(fsp_err_t err);
/*******************************************************************************************************************//**
 * main() is generated by the RA Configuration editor and is used to generate threads if an RTOS is used.  This function
 * is called by main() when no RTOS is used.
 **********************************************************************************************************************/
void hal_entry(void)
{
    /* TODO: add your own code here */
    fsp_err_t err;
    /* Initialize EtherCAT SSC Port */
    err = RM_ETHERCAT_SSC_PORT_Open(gp_ethercat_ssc_port->p_ctrl, gp_ethercat_ssc_port->p_cfg);
    handle_error(err);

    /* Initilize the stack */
    MainInit();
#if (CiA402_SAMPLE_APPLICATION == 1)
    /* Initialize axis structures */
    CiA402_Init();
#endif

    /* Create basic mapping */
    APPL_GenerateMapping(&nPdInputSize,&nPdOutputSize);

    /* Set stack run flag */
    bRunApplication = TRUE;

    /* Execute the stack */
    while(bRunApplication == TRUE)
    {
        MainLoop();
    }

#if (CiA402_SAMPLE_APPLICATION == 1)
    /* Remove all allocated axes resources */
    CiA402_DeallocateAxis();
#endif
    /* Close SSC Port */
    RM_ETHERCAT_SSC_PORT_Close(gp_ethercat_ssc_port->p_ctrl);

    while(1);
    /* Wake up 2nd core if this is first core and we are inside a multicore project. */
#if (0 == _RA_CORE) && (1 == BSP_MULTICORE_PROJECT) && !BSP_TZ_NONSECURE_BUILD

#if BSP_TZ_SECURE_BUILD
    /* Take semaphore so 2nd core can clear it */
    R_BSP_IpcSemaphoreTake(&g_core_start_semaphore);
#endif

    R_BSP_SecondaryCoreStart();

#if BSP_TZ_SECURE_BUILD
    /* Wait for 2nd core to start and clear semaphore */
    while(FSP_ERR_IN_USE == R_BSP_IpcSemaphoreTake(&g_core_start_semaphore))
    {
        ;
    }
#endif
#endif

#if (1 == _RA_CORE) && (1 == BSP_MULTICORE_PROJECT) && BSP_TZ_SECURE_BUILD
    /* Signal to 1st core that 2nd core has started */
    R_BSP_IpcSemaphoreGive(&g_core_start_semaphore);
#endif

#if BSP_TZ_SECURE_BUILD
    /* Enter non-secure code */
    R_BSP_NonSecureEnter();
#endif
}

/* Function Name: handle_error */
/******************************************************************************************************************//**
 * @brief Check if an error occurs

 * @param[in] fsp_err_t err
 *********************************************************************************************************************/
void handle_error(fsp_err_t err)
{
    if (err != FSP_SUCCESS)
    {
        __NOP();
    }

}

#if BSP_TZ_SECURE_BUILD

FSP_CPP_HEADER
BSP_CMSE_NONSECURE_ENTRY void template_nonsecure_callable ();

/* Trustzone Secure Projects require at least one nonsecure callable function in order to build (Remove this if it is not required to build). */
BSP_CMSE_NONSECURE_ENTRY void template_nonsecure_callable ()
{

}
FSP_CPP_FOOTER

#endif
