#include "arm_2d.h"
#include "arm_2d_disp_adapter_0.h"
#include "console.h"
#include "hal_data.h"

#include "lcd/lcd.h"
#include "utils/log.h"

#if (1 == BSP_MULTICORE_PROJECT) && BSP_TZ_SECURE_BUILD
bsp_ipc_semaphore_handle_t g_core_start_semaphore =
{
    .semaphore_num = 0
};
#endif

static LCD_Device s_lcd;
static volatile uint32_t s_tick_ms;

/*******************************************************************************************************************//**
 * main() is generated by the RA Configuration editor and is used to generate threads if an RTOS is used.  This function
 * is called by main() when no RTOS is used.
 **********************************************************************************************************************/
void hal_entry(void)
{
	/* TODO: add your own code here */
#if CONSOLE_CFG_USE_UART == 0
	R_SCI_B_UART_Open(g_uart9.p_ctrl, g_uart9.p_cfg);
#endif

#if CONSOLE_CFG_USE_RTT
	CONSOLE_Init();
#endif
	LOG_Reset();

	s_lcd.orientation = SCREEN_ORIENTATION_VERTICAL;
	LCD_Init(&s_lcd);

	arm_2d_init();
	disp_adapter0_init();
#if CONSOLE_CFG_USE_LCD
	CONSOLE_Init();
	arm_2d_scene_player_set_switching_mode(&DISP0_ADAPTER, ARM_2D_SCENE_SWITCH_MODE_FADE_WHITE);
	arm_2d_scene_player_switch_to_next_scene(&DISP0_ADAPTER);
#endif

	R_GPT_Open(g_timer1.p_ctrl, g_timer1.p_cfg);
	R_GPT_Start(g_timer1.p_ctrl);

	R_IPC_Open(g_ipc0.p_ctrl, g_ipc0.p_cfg);
	R_IPC_Open(g_ipc1.p_ctrl, g_ipc1.p_cfg);
	R_IPC_EventGenerate(g_ipc0.p_ctrl, IPC_GENERATE_EVENT_IRQ1);

	/* Wake up 2nd core if this is first core and we are inside a multicore project. */
#if (0 == _RA_CORE) && (1 == BSP_MULTICORE_PROJECT) && !BSP_TZ_NONSECURE_BUILD

#if BSP_TZ_SECURE_BUILD
    /* Take semaphore so 2nd core can clear it */
    R_BSP_IpcSemaphoreTake(&g_core_start_semaphore);
#endif

    R_BSP_SecondaryCoreStart();

#if BSP_TZ_SECURE_BUILD
    /* Wait for 2nd core to start and clear semaphore */
    while(FSP_ERR_IN_USE == R_BSP_IpcSemaphoreTake(&g_core_start_semaphore))
    {
        ;
    }
#endif
#endif

#if (1 == _RA_CORE) && (1 == BSP_MULTICORE_PROJECT) && BSP_TZ_SECURE_BUILD
    /* Signal to 1st core that 2nd core has started */
    R_BSP_IpcSemaphoreGive(&g_core_start_semaphore);
#endif

    while (1) {
    	CONSOLE_Task();
    	disp_adapter0_task();
    }

#if BSP_TZ_SECURE_BUILD
    /* Enter non-secure code */
    R_BSP_NonSecureEnter();
#endif
}

#if BSP_TZ_SECURE_BUILD

FSP_CPP_HEADER
BSP_CMSE_NONSECURE_ENTRY void template_nonsecure_callable ();

/* Trustzone Secure Projects require at least one nonsecure callable function in order to build (Remove this if it is not required to build). */
BSP_CMSE_NONSECURE_ENTRY void template_nonsecure_callable ()
{

}
FSP_CPP_FOOTER

#endif

#if (LOG_CFG_HAS_STDIO == 0) && (LOG_CFG_EN_SEGGER_RTT == 0)
void LOG_Puts(const char *str)
{
	int i;

	for (i = 0; str[i]; i++) {
		g_uart9_ctrl.p_reg->TDR_BY = str[i];
		while ((g_uart9_ctrl.p_reg->CSR & R_SCI_B0_CSR_TDRE_Msk) == 0) {}
	}
}
#endif

int32_t Disp0_DrawBitmap(int16_t x, int16_t y, int16_t width, int16_t height, const uint8_t *bitmap)
{
	LCD_PortDrawBitmap(&s_lcd, (uint16_t)x, (uint16_t)y, (uint16_t)width, (uint16_t)height, bitmap);

	return 0;
}

int64_t arm_2d_helper_get_system_timestamp(void)
{
	return (int64_t) s_tick_ms;
}

uint32_t arm_2d_helper_get_reference_clock_frequency(void)
{
	return 1000u;
}

void IPC1_Callback(ipc_callback_args_t *p_args)
{
	switch (p_args->event) {
	case IPC_EVENT_IRQ0:
		CONSOLE_IPCIrqHandle();
		break;
	case IPC_EVENT_IRQ1:
		break;
	case IPC_EVENT_IRQ2:
		break;
	case IPC_EVENT_IRQ3:
		break;
	case IPC_EVENT_IRQ4:
		break;
	case IPC_EVENT_IRQ5:
		break;
	case IPC_EVENT_IRQ6:
		break;
	case IPC_EVENT_IRQ7:
		break;
	case IPC_EVENT_MESSAGE_RECEIVED:
		CONSOLE_IPCMsgHandle(p_args->message);
		break;
	case IPC_EVENT_FIFO_ERROR_EMPTY:
		LOG_W(__FUNCTION__, "IPC FIFO Empty");
		break;
	case IPC_EVENT_FIFO_ERROR_FULL:
		LOG_W(__FUNCTION__, "IPC FIFO Full");
		break;
	default:
		break;
	}
}

void TIMER1_Callback(timer_callback_args_t *p_args)
{
	if (p_args->event == TIMER_EVENT_CYCLE_END) {
		s_tick_ms++;
	}
}

#if CONSOLE_CFG_USE_UART == 0
void UART9_Callback(uart_callback_args_t *p_args)
{
	(void)p_args;
}
#endif
