#include "console.h"
#include "hal_data.h"

#include "perf_counter/perf_counter.h"
#include "utils/log.h"

#if (1 == BSP_MULTICORE_PROJECT) && BSP_TZ_SECURE_BUILD
bsp_ipc_semaphore_handle_t g_core_start_semaphore =
{
    .semaphore_num = 0
};
#endif

static bool s_core1_ready = false;
static volatile uint8_t s_event;
static uint32_t s_cnt;

/*******************************************************************************************************************//**
 * main() is generated by the RA Configuration editor and is used to generate threads if an RTOS is used.  This function
 * is called by main() when no RTOS is used.
 **********************************************************************************************************************/
void hal_entry(void)
{
	/* TODO: add your own code here */
	perfc_init(false);
	R_GPT_Open(g_timer0.p_ctrl, g_timer0.p_cfg);
	R_GPT_Start(g_timer0.p_ctrl);

	R_IPC_Open(g_ipc0.p_ctrl, g_ipc0.p_cfg);
	R_IPC_Open(g_ipc1.p_ctrl, g_ipc1.p_cfg);

	/* Wake up 2nd core if this is first core and we are inside a multicore project. */
#if (0 == _RA_CORE) && (1 == BSP_MULTICORE_PROJECT) && !BSP_TZ_NONSECURE_BUILD

#if BSP_TZ_SECURE_BUILD
    /* Take semaphore so 2nd core can clear it */
    R_BSP_IpcSemaphoreTake(&g_core_start_semaphore);
#endif

    R_BSP_SecondaryCoreStart();
    while (s_core1_ready == false) {
    	R_BSP_SoftwareDelay(10, BSP_DELAY_UNITS_MICROSECONDS);
    }
    R_BSP_SoftwareDelay(30, BSP_DELAY_UNITS_MILLISECONDS);
    CONSOLE_Init();

#if BSP_TZ_SECURE_BUILD
    /* Wait for 2nd core to start and clear semaphore */
    while(FSP_ERR_IN_USE == R_BSP_IpcSemaphoreTake(&g_core_start_semaphore))
    {
        ;
    }
#endif
#endif

#if (1 == _RA_CORE) && (1 == BSP_MULTICORE_PROJECT) && BSP_TZ_SECURE_BUILD
    /* Signal to 1st core that 2nd core has started */
    R_BSP_IpcSemaphoreGive(&g_core_start_semaphore);
#endif

#if BSP_TZ_SECURE_BUILD
    /* Enter non-secure code */
    R_BSP_NonSecureEnter();
#endif

    while (1) {
    	if (s_event) {
    		s_event = 0;
    		if ((s_cnt % 10) == 0) {
    			printf("\r\nYou can directly print string to LCD with printf()\r\n");
    		}
    		printf("Current cnt: %u\r\n", s_cnt);
    		s_cnt++;
    	}
    }
}

void IPC0_Callback(ipc_callback_args_t *p_args)
{
	switch (p_args->event) {
	case IPC_EVENT_IRQ0:
		CONSOLE_IPCIrqHandle();
		break;
	case IPC_EVENT_IRQ1:
		s_core1_ready = true;
		break;
	case IPC_EVENT_IRQ2:
		break;
	case IPC_EVENT_IRQ3:
		break;
	case IPC_EVENT_IRQ4:
		break;
	case IPC_EVENT_IRQ5:
		break;
	case IPC_EVENT_IRQ6:
		break;
	case IPC_EVENT_IRQ7:
		break;
	case IPC_EVENT_MESSAGE_RECEIVED:
		CONSOLE_IPCMsgHandle(p_args->message);
		/* You can add your other application code here */
		break;
	case IPC_EVENT_FIFO_ERROR_EMPTY:
		LOG_W(__FUNCTION__, "IPC FIFO Empty");
		break;
	case IPC_EVENT_FIFO_ERROR_FULL:
		LOG_W(__FUNCTION__, "IPC FIFO Full");
		break;
	default:
		break;
	}
}

void TIMER0_Callback(timer_callback_args_t * p_args)
{
	bsp_io_level_t level;

	if (p_args->event == TIMER_EVENT_CYCLE_END) {
		R_IOPORT_PinRead(g_ioport.p_ctrl, USER_LED, &level);
		if (level == BSP_IO_LEVEL_HIGH) {
			R_IOPORT_PinWrite(g_ioport.p_ctrl, USER_LED, BSP_IO_LEVEL_LOW);
		}
		else {
			R_IOPORT_PinWrite(g_ioport.p_ctrl, USER_LED, BSP_IO_LEVEL_HIGH);
		}
		s_event = 1;
	}
}

#if BSP_TZ_SECURE_BUILD

FSP_CPP_HEADER
BSP_CMSE_NONSECURE_ENTRY void template_nonsecure_callable ();

/* Trustzone Secure Projects require at least one nonsecure callable function in order to build (Remove this if it is not required to build). */
BSP_CMSE_NONSECURE_ENTRY void template_nonsecure_callable ()
{

}
FSP_CPP_FOOTER

#endif
